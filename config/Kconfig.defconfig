## config/Kconfig.defconfig
```kconfig
# Copyright (c) 2020 The ZMK Contributors
# SPDX-License-Identifier: MIT

if SHIELD_XJAM_LEFT

config ZMK_KEYBOARD_NAME
	default "XJam"

config ZMK_SPLIT_BLE_ROLE_CENTRAL
	default y

endif

if SHIELD_XJAM_LEFT || SHIELD_XJAM_RIGHT

config ZMK_SPLIT
	default y

endif
```

## config/Kconfig.shield
```kconfig
# Copyright (c) 2020 The ZMK Contributors
# SPDX-License-Identifier: MIT

config SHIELD_XJAM_LEFT
	def_bool $(shields_list_contains,xjam_left)

config SHIELD_XJAM_RIGHT
	def_bool $(shields_list_contains,xjam_right)
```
